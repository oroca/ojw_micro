#include <OpenJigWare.h>

using namespace Ojw;


const uint8_t motion[240] PROGMEM = 
{ 
0x44, 0x4D, 0x54, 0x31, 0x2E, 0x30, 0x00, 0x00, 0x00, 0x00, 
0x00, 0x00, 0x00, 0x00, 0x00, 0x00, 0x00, 0x00, 0x00, 0x00, 
0x00, 0x00, 0x00, 0x00, 0x00, 0x00, 0x00, 0x00, 0x05, 0x00, 
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0x00, 0x00, 0x00, 0x00, 0x00, 0x00, 0x4D, 0x45, 0x46, 0x45 

};

Ojw::CMotion ojw_motion;


void motionStartFunc(SMotionHeader_t *p_header);
bool motionMotorFunc(SMotionHeader_t *p_header, SMotionTableDB_t *p_table);


void setup() {
  // put your setup code here, to run once:
  Serial.begin(115200);

  // ojw 모션 설정 
  //
  ojw_motion.setMotionMotorCallback(motionMotorFunc);
  ojw_motion.setMotionStartCallback(motionStartFunc);
  ojw_motion.addMotionFile(0, "go", motion);  
}

void loop() {
  // put your main code here, to run repeatedly:
  if (Serial.available() > 0)
  {
    if (Serial.read() == '1')
    {
      ojw_motion.playMotion("go");
    }
  }  
}

void motionStartFunc(SMotionHeader_t *p_header)
{
  Serial.println("nFrameSize      \t " + String(p_header->nFrameSize));
  Serial.println("nCommentSize    \t " + String(p_header->nCommentSize));
  Serial.println("nCnt_LineComment\t " + String(p_header->nCnt_LineComment));
  Serial.println("nPlayTime       \t " + String(p_header->nPlayTime));
  Serial.println("nRobotModelNum  \t " + String(p_header->nRobotModelNum));
  Serial.println("nMotorCnt       \t " + String(p_header->nMotorCnt));
}

bool motionMotorFunc(SMotionHeader_t *p_header, SMotionTableDB_t *p_table)
{
  bool stop_motion = false;


  Serial.println("nTime  : " + String(p_table->nTime));
  Serial.println("nDelay : " + String(p_table->nDelay));
  
  for (int nAxis = 0; nAxis < p_header->nMotorCnt; nAxis++)
  {
    Serial.println("Mot[" + String(nAxis) + "] = " + String(p_table->pnMot[nAxis]));
  }
  Serial.println("---\n");
  
  return stop_motion;
}

